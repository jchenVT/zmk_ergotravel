## config/boards/Kconfig.defconfig
```kconfig
if SHIELD_ERGOTRAVEL_LEFT

config ZMK_KEYBOARD_NAME
	default "Ergo Travel Left"

config ZMK_SPLIT_BLE_ROLE_CENTRAL
	default y

endif


if SHIELD_ERGOTRAVEL_RIGHT

config ZMK_KEYBOARD_NAME
	default "Ergo Travel Right"

config USB
	default y

endif

if SHIELD_ERGOTRAVEL_LEFT || SHIELD_ERGOTRAVEL_RIGHT

config ZMK_SPLIT
	default y


endif
```

## config/boards/Kconfig.shield
```kconfig
# Copyright (c) 2020 Pete Johanson
# SPDX-License-Identifier: MIT

config SHIELD_ERGOTRAVEL_LEFT
	def_bool $(shields_list_contains,ergotravel_left)

config SHIELD_ERGOTRAVEL_RIGHT
	def_bool $(shields_list_contains,ergotravel_right)
```

## config/boards/shields/ergotravel/Kconfig.defconfig
```kconfig
if SHIELD_ERGOTRAVEL_LEFT

config ZMK_KEYBOARD_NAME
	default "Ergotravel Left"

config ZMK_SPLIT_BLE_ROLE_CENTRAL
	default y

endif


if SHIELD_ERGOTRAVEL_RIGHT

config ZMK_KEYBOARD_NAME
	default "Ergotravel Right"

config USB
	default y

endif

if SHIELD_ERGOTRAVEL_LEFT || SHIELD_ERGOTRAVEL_RIGHT

config ZMK_SPLIT
	default y


endif
```
